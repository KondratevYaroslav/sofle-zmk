/*
 * Copyright (c) 2020 Ryan Cross
 *
 * SPDX-License-Identifier: MIT
 */



&default_transform {
	col-offset = <6>;
};

&kscan0 {
    wakeup-source;
	col-gpios
		= <&pro_micro 10 GPIO_ACTIVE_HIGH>
		, <&pro_micro 16 GPIO_ACTIVE_HIGH>
		, <&pro_micro 14 GPIO_ACTIVE_HIGH>
		, <&pro_micro 15 GPIO_ACTIVE_HIGH>
		, <&pro_micro 18 GPIO_ACTIVE_HIGH>
		, <&pro_micro 19 GPIO_ACTIVE_HIGH>
		;
};

&right_encoder {
	status = "okay";
};

// Настройки для пробуждения устройства
soft_off_wakers {
    compatible = "zmk,soft-off-wakeup-sources";
    wakeup-sources = <&kscan0>;  // Указываем kscan0 как источник пробуждения
