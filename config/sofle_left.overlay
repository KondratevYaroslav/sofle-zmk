/*
 * Copyright (c) 2020 Ryan Cross
 *
 * SPDX-License-Identifier: MIT
 */


/{
	side_band_behavior_triggers: side_band_behavior_triggers {
		compatible = "zmk,kscan-sideband-behaviors";
		wakeup-source;
		kscan = <&kscan0>;
		soft_off {
			column = <0>;
			row = <0>;
			bindings = <&hw_soft_off>;
		};
	};

};
